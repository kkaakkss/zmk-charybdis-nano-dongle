## boards/shields/nano35/Kconfig.defconfig
```kconfig
if SHIELD_NANO35_DONGLE || SHIELD_NANO35_LEFT || SHIELD_NANO35_RIGHT
config ZMK_KEYBOARD_NAME
    default "Nano35 Dongle"
config ZMK_SPLIT
    default y
endif

if SHIELD_NANO35_DONGLE
config ZMK_SPLIT_ROLE_CENTRAL
    default y
endif
```

## boards/shields/nano35/Kconfig.shield
```kconfig
config SHIELD_NANO35_DONGLE
    def_bool $(shields_list_contains,nano35_dongle)
config SHIELD_NANO35_LEFT
    def_bool $(shields_list_contains,nano35_left)
config SHIELD_NANO35_RIGHT
    def_bool $(shields_list_contains,nano35_right)
```

## config/west.yml
```yaml
manifest:
  remotes:
    - name: zmkfirmware
      url-base: https://github.com/zmkfirmware
    - name: badjeff
      url-base: https://github.com/badjeff
  projects:
    - name: zmk
      remote: zmkfirmware
      revision: acfd8e5ea76cf23ad1c9b6b99848f97a95224257
      import: app/west.yml
    - name: zmk-pmw3610-driver
      remote: badjeff
      revision: 14d39b7a6944d1014544a2382707b14724c22f49
  self:
    path: config
```

## dts/bindings/behaviors/nano35,ball-speed.yaml
```yaml
description: Independent Move/Scroll/Snipe multiplier steps (0/1 Move, 2/3 Scroll, 4/5 Snipe, 6/7 Faster trim; even slower, odd faster)
compatible: "nano35,ball-speed"
include: one_param.yaml
```

## dts/bindings/behaviors/nano35,pomodoro.yaml
```yaml
description: Nano35 one-shot timer (5/10/25 minutes restart, 0 stop and hide)
compatible: "nano35,pomodoro"
include: one_param.yaml
```

## dts/bindings/input_processors/nano35,trackball-modes.yaml
```yaml
description: Nano35 central-side Keyball mouse, scroll and snipe modes
compatible: "nano35,trackball-modes"
include: ip_zero_param.yaml
properties:
  mouse-layer:
    type: int
    required: true
  scroll-layer:
    type: int
    required: true
  snipe-layer:
    type: int
    required: true
  automouse-timeout-ms:
    type: int
    required: true
  temporary-layer:
    type: phandle
    required: true
```
