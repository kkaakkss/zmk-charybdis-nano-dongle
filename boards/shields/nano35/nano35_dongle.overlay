#include "nano35.dtsi"
#include <input/processors/temp_layer.dtsi>
&kscan0 {
    compatible = "zmk,kscan-mock";
    columns = <0>;
    rows = <0>;
    events = <0>;
};
/ {
    trackball_listener {
        compatible = "zmk,input-listener";
        device = <&trackball_split>;
        input-processors = <&nano35_ball_modes>;
    };
};

/ {
    nano35_ball_modes: nano35_ball_modes {
        compatible = "nano35,trackball-modes";
        #input-processor-cells = <0>;
        mouse-layer = <4>;
        scroll-layer = <5>;
        snipe-layer = <6>;
        faster-layer = <7>;
        automouse-timeout-ms = <30000>;
        temporary-layer = <&zip_temp_layer>;
    };
};
